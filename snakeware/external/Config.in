## snakeware/external/Config.in
```kconfig
source "$BR2_EXTERNAL_SNAKEWARE_PATH/package/python-pygame-gui/Config.in"
source "$BR2_EXTERNAL_SNAKEWARE_PATH/package/python-pyttsx3/Config.in"
source "$BR2_EXTERNAL_SNAKEWARE_PATH/package/python-moderngl/Config.in"
source "$BR2_EXTERNAL_SNAKEWARE_PATH/package/python-moderngl-window/Config.in"
source "$BR2_EXTERNAL_SNAKEWARE_PATH/package/python-pyrr/Config.in"
```

## snakeware/external/package/python-freetype-py/Config.in
```kconfig
config BR2_PACKAGE_PYTHON_FREETYPE_PY
    bool "python-freetype-py"
    depends on BR2_PACKAGE_FREETYPE  # System FreeType lib
    help
      Python bindings for FreeType font library.
```

## snakeware/external/package/python-glcontext/Config.in
```kconfig
config BR2_PACKAGE_PYTHON_GLCONTEXT
    bool "python-glcontext"
    help
      Portable OpenGL context creation for Python.
```

## snakeware/external/package/python-moderngl-window/Config.in
```kconfig
config BR2_PACKAGE_PYTHON_MODERNGL_WINDOW
    bool "python-moderngl-window"
    depends on BR2_PACKAGE_PYTHON_MODERNGL
    help
      Cross-platform utility library for ModernGL.
```

## snakeware/external/package/python-moderngl/Config.in
```kconfig
config BR2_PACKAGE_PYTHON_MODERNGL
    bool "python-moderngl"
    help
      ModernGL: Modern OpenGL binding for Python.
```

## snakeware/external/package/python-multipledispatch/Config.in
```kconfig
config BR2_PACKAGE_PYTHON_MULTIPLEDISPATCH
    bool "python-multipledispatch"
    help
      Multiple dispatch for Python.
```

## snakeware/external/package/python-pyrr/Config.in
```kconfig
config BR2_PACKAGE_PYTHON_PYRR
    bool "python-pyrr"
    depends on BR2_PACKAGE_PYTHON_NUMPY
    help
      3D mathematical functions using NumPy.
```
